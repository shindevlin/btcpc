## clients/btcpc-flipper/esp32-bridge/sdkconfig.defaults
```kconfig
# Target: ESP32-S2 (Flipper WiFi dev board)
CONFIG_IDF_TARGET="esp32s2"

# WiFi
CONFIG_ESP_WIFI_STATIC_RX_BUFFER_NUM=4
CONFIG_ESP_WIFI_DYNAMIC_RX_BUFFER_NUM=8
CONFIG_ESP32_WIFI_NVS_ENABLED=y

# UART
CONFIG_ESP_CONSOLE_NONE=y

# Task stack
CONFIG_MAIN_TASK_STACK_SIZE=8192

# mDNS
CONFIG_MDNS_MAX_SERVICES=5
```
